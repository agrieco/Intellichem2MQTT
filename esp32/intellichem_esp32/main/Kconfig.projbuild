## esp32/intellichem_esp32/main/Kconfig.projbuild
```kconfig
menu "IntelliChem2MQTT Configuration"

    menu "IntelliChem Settings"
        config INTELLICHEM_ADDRESS
            int "IntelliChem Address"
            default 144
            range 144 158
            help
                RS-485 address of IntelliChem controller (144-158)

        config INTELLICHEM_POLL_INTERVAL
            int "Poll Interval (seconds)"
            default 30
            range 5 300
            help
                How often to request status from IntelliChem

        config INTELLICHEM_TIMEOUT_MS
            int "Response Timeout (milliseconds)"
            default 5000
            range 1000 30000
            help
                How long to wait for IntelliChem response
    endmenu

    menu "Serial Port Settings"
        config UART_PORT_NUM
            int "UART Port Number"
            default 1
            range 0 2
            help
                UART port to use for RS-485 communication

        config UART_TX_PIN
            int "UART TX GPIO"
            default 4
            range 0 21
            help
                GPIO pin for UART TX (connect to RS-485 DI)
                ESP32-C3 safe pins: 0-10, 18-19 are USB, 11-17 may be flash

        config UART_RX_PIN
            int "UART RX GPIO"
            default 5
            range 0 21
            help
                GPIO pin for UART RX (connect to RS-485 RO)
                ESP32-C3 safe pins: 0-10, 18-19 are USB, 11-17 may be flash

        config RS485_DE_PIN
            int "RS-485 DE/RE GPIO"
            default 6
            range -1 21
            help
                GPIO pin for RS-485 direction control (connect to DE/RE)
                Set to -1 to disable (for auto-direction transceivers)
                ESP32-C3 safe pins: 0-10

        config UART_BAUD_RATE
            int "Baud Rate"
            default 9600
            help
                Serial baud rate (9600 for IntelliChem)
    endmenu

    menu "WiFi Settings"
        config WIFI_SSID
            string "WiFi SSID"
            default "MyNetwork"
            help
                WiFi network name

        config WIFI_PASSWORD
            string "WiFi Password"
            default "MyPassword"
            help
                WiFi network password
    endmenu

    menu "MQTT Settings"
        config MQTT_BROKER_URI
            string "MQTT Broker URI"
            default "mqtt://192.168.1.100:1883"
            help
                MQTT broker URI (e.g., mqtt://host:1883 or mqtts://host:8883)

        config MQTT_USERNAME
            string "MQTT Username"
            default ""
            help
                MQTT username (leave empty for anonymous)

        config MQTT_PASSWORD
            string "MQTT Password"
            default ""
            help
                MQTT password

        config MQTT_TOPIC_PREFIX
            string "MQTT Topic Prefix"
            default "intellichem2mqtt"
            help
                Prefix for all MQTT topics

        config MQTT_DISCOVERY_PREFIX
            string "HA Discovery Prefix"
            default "homeassistant"
            help
                Home Assistant discovery topic prefix

        config MQTT_KEEPALIVE
            int "MQTT Keepalive (seconds)"
            default 60
            range 10 300
            help
                MQTT keepalive interval in seconds

        config MQTT_QOS
            int "MQTT QoS Level"
            default 1
            range 0 2
            help
                MQTT Quality of Service level (0=At most once, 1=At least once, 2=Exactly once)

        config CONTROL_ENABLED
            bool "Enable Control Features"
            default y
            help
                Enable control features (setpoint changes, dosing enable/disable).
                When disabled, IntelliChem operates in read-only monitoring mode.
    endmenu

    menu "Logging"
        config LOG_LEVEL_PROTOCOL
            int "Protocol Log Level"
            default 4
            range 0 5
            help
                Log level for protocol components (0=None, 1=Error, 2=Warn, 3=Info, 4=Debug, 5=Verbose)
    endmenu

endmenu
```

## esp32/intellichem_esp32/sdkconfig.defaults
```kconfig
# IntelliChem2MQTT Default Configuration

# Use custom partition table with larger app partition
CONFIG_PARTITION_TABLE_CUSTOM=y
CONFIG_PARTITION_TABLE_CUSTOM_FILENAME="partitions.csv"

# Target ESP32-C3 with 4MB flash
CONFIG_IDF_TARGET="esp32c3"
CONFIG_ESPTOOLPY_FLASHSIZE_4MB=y
CONFIG_ESPTOOLPY_FLASHSIZE="4MB"

# Enable UART driver
CONFIG_ESP_CONSOLE_UART_DEFAULT=y
```
